## conf/machine/cfa-10022.conf
```bitbake
#@TYPE: Machine
#@Name: Crystalfontz 10022
#@DESCRIPTION: Machine configuration for a cfa-10022 with a at91sam9g45 processor

TARGET_ARCH = "arm"

PREFERRED_PROVIDER_virtual/kernel = "linux-cfa-10022"
PREFERRED_VERSION_linux = "2.6.30"
PREFERRED_PROVIDER_xserver = "xserver-kdrive"

KERNEL_IMAGETYPE = "uImage"
PREFERRED_VERSION_u-boot = "2009.01"
UBOOT_MACHINE = "cfa_10022_config"

UBOOT_ENTRYPOINT = "0x70008000"
UBOOT_LOADADDRESS = "0x70008000"

PREFERRED_VERSION_at91bootstrap = "2.10"

#don't try to access tty1
USE_VT = "0"

MACHINE_FEATURES = "kernel26 alsa ext2 usbhost usbgadget"
#EXTRA_IMAGEDEPENDS += "u-boot"
#EXTRA_IMAGEDEPENDS += "at91bootstrap"

# used by sysvinit_2
SERIAL_CONSOLE = "115200 ttyS0"
IMAGE_FSTYPES ?= "jffs2"
EXTRA_IMAGECMD_jffs2 = "--pad --little-endian --eraseblock=0x20000 -n"

require conf/machine/include/tune-arm926ejs.inc
```
